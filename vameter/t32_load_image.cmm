; Basic setup
  RESet
  SYStem.RESet
  SYStem.CPU STM32F100C8
  SYStem.CONFIG.DEBUGPORTTYPE SWD
  SYStem.CONFIG.CONNECTOR MIPI20T
  SYStem.MemAccess DAP
  SYStem.Option DUALPORT ON
  SYStem.Up

;;;;;;;;;;;;;;;;;;;;;;;;;;;;;;;;;;;;;;;;;;
; Flash programming warning
  DIALOG.YESNO "Do you want to flash the device? (No starts the program without flashing)"
  LOCAL &progflash
  ENTRY &progflash
  IF &progflash
  (
    ; Setup flash configuration using the board support scripts of the TRACE32 installation
    DO t32_stm32f10x.cmm PREPAREONLY DUALPORT=1 

    ; Program the internal flash
    FLASH.ReProgram.ALL /Erase
    Data.LOAD.Elf ~~~~/build_windows_debug/app/bin/vameter.elf /NosYmbol
    FLASH.ReProgram.off

    ; Reset device
    SYStem.Down
    SYStem.Up
  )

  ; Loading symbol information
  Data.LOAD.Elf ~~~~/build_windows_debug/app/bin/vameter.elf /NoCODE

; Prevent error during power saving states and stop peripherals in debug mode
  Data.Set E:0xE0042004 %Long 0yXXXXxxxxXXX11111XXXXxxxxXXXXx111  ; DBGMCU_CR

; The independent watchdog counter clock is stopped when the core is halted
  Data.Set E:0xE0042008 %Long 0yXXXXxxxxXXXXxxxxXXX1xxxxXXXXxxxx  ; DBGMCU_APB1_FZ

; Setup GPIO clock
; Data.Set E:0x40023830 %Long 0yXXXXxxxxXXXXxxxxXXXXxxxxXXX1xxxx  ; RCC_AHB1ENR
; Setup pin multiplexing for using the 4 bit trace
  Data.Set E:0x40021000 %Long 0yXXXXxxxxXXXXxxxxXX1010101010xxxx  ; GPOIE_PORTMODE
  Data.Set E:0x40021008 %Long 0yXXXXxxxxXXXXxxxxXX1111111111xxxx  ; GPOIE_PORTSPEED
  Data.Set E:0x40021020 %Long 0yXXXX00000000000000000000XXXXxxxx  ; GPIOE_AFRL

  ; Turn on ITM and ETM
  ; ETM.ON
  ; ITM.ON

  ; ETM.PortMode Continuous
  ; ETM.PortSize 4.

; Select the Analyzer (PowerTrace with Preprocessor)
;  IF CAnalyzer()
;  (
;    Trace.METHOD CAnalyzer   ; Using CombiProbe
;  )
;  ELSE IF Analyzer()
;  (
;    Trace.METHOD Analyzer    ; Using ARM preprocessor
;    Analyzer.Init
;    Analyzer.AutoFocus
;  )
  ITM.PCSampler 1/64
  Trace.OFF              ; Enable the trace and turn it off
  B.set main
  Go.direct
  Wait !State.Run()
  IF CAnalyzer()
  (
    Trace.METHOD CAnalyzer   ; Using CombiProbe
  )
  ELSE IF Analyzer()
  (
    Trace.METHOD Analyzer    ; Using ARM preprocessor
    Analyzer.Init
    Analyzer.AutoFocus
    ;ANALYZER.TERMINATION ON
    ;ANALYZER.THRESHOLD  1.48 1.65
    ;ANALYZER.SAMPLE    TP0    -2.106
    ;ANALYZER.SAMPLE    TP1    -1.482
    ;ANALYZER.SAMPLE    TP2    -2.262
    ;ANALYZER.SAMPLE    TP3    -2.184
  )
  
  ; open some windows
  WinCLEAR


  WinPOS 0% 0% 50% 50%
  List.Hll

  WinPOS 50% 0% 50% 50%
  Trace.List

  WinPOS 0% 50% 50% 50%
  ITMTrace.list

  WinPOS 50% 50% 50% 50%
  Var.Watch %hex

  ENDDO
